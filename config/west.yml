## config/west.yml
```yaml
manifest:
  remotes:
    - name: zmkfirmware
      url-base: https://github.com/zmkfirmware
    - name: me
      url-base: https://github.com/Nick-Munnich
    # Additional modules containing boards/shields/custom code can be listed here as well
    # See https://docs.zephyrproject.org/3.2.0/develop/west/manifest.html#projects
  projects:
    - name: zmk
      remote: me
      revision: ba170011c92e5de52cd47557ebd9faf3277dbcb5
      import: app/west.yml
  self:
    path: config
```
